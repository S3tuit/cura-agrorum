## firmware/components/node_sensors/Kconfig
```kconfig
menu "Cura Agrorum sensor board configuration"

    config CURA_SEN0193_0
        int "SEN0193 plus DS18B20 slot 0 (0/1)"
        range 0 1
        default 0

    config CURA_SEN0193_1
        int "SEN0193 plus DS18B20 slot 1 (0/1)"
        range 0 1
        default 0

    config CURA_SEN0600_0
        int "SEN0600 slot 0 Modbus address (0 disables)"
        range 0 254
        default 1

    config CURA_SEN0600_1
        int "SEN0600 slot 1 Modbus address (0 disables)"
        range 0 254
        default 0

    config CURA_SOIL_0_GPIO
        int "Soil sensor channel 0 ADC GPIO"
        range 1 1
        default 1
        help
            Fixed XIAO ESP32S3 wiring; see firmware/HARDWARE.md.

    config CURA_SOIL_1_GPIO
        int "Soil sensor channel 1 ADC GPIO"
        range 2 2
        default 2
        help
            Fixed XIAO ESP32S3 wiring; see firmware/HARDWARE.md.

    config CURA_SOIL_ADC_GPIO
        int "Standalone maintenance soil ADC GPIO"
        range 1 2
        default CURA_SOIL_0_GPIO
        help
            Compatibility setting used by maintenance applications that call
            soil_sensor_read_mv() directly. Production node_sensors sampling
            uses CURA_SOIL_0_GPIO and CURA_SOIL_1_GPIO instead.

    config CURA_SENSOR_POWER_GATE_GPIO
        int "Switched sensor rail GPIO"
        range 44 44
        default 44
        help
            SEN0193 uses active-low open drain. SEN0600 uses active-high
            push-pull through the NPN stage. Selection determines the mode.

    config CURA_SENSOR_POWER_STABILIZATION_MS
        int "Switched sensor rail stabilization time (ms)"
        range 1 5000
        default 450 if CURA_SEN0600_0 > 0
        default 200
        help
            Delay from rail enable to acquisition. The SEN0600 fixture
            supports 450 ms; changes require sensor startup evidence.

    config CURA_DS18B20_GPIO
        int "DS18B20 1-Wire GPIO"
        range 4 4
        default 4

    config CURA_DS18B20_0_ROM
        string "DS18B20 channel 0 ROM identity"
        default ""
        help
            Nonzero 16-hex-digit ROM when SEN0193 slot 0 is enabled;
            empty otherwise. Discover ROMs with the maintenance app.

    config CURA_DS18B20_1_ROM
        string "DS18B20 channel 1 ROM identity"
        default ""
        help
            Nonzero 16-hex-digit ROM when SEN0193 slot 1 is enabled;
            empty otherwise. Enabled identities must differ.

    config CURA_I2C_SDA_GPIO
        int "BME280 I2C SDA GPIO"
        range 5 5
        default 5

    config CURA_I2C_SCL_GPIO
        int "BME280 I2C SCL GPIO"
        range 6 6
        default 6

endmenu
```

## firmware/maintenance/ds18b20_discovery/sdkconfig.defaults
```kconfig
CONFIG_ESPTOOLPY_FLASHSIZE_8MB=y
CONFIG_ESPTOOLPY_FLASHSIZE="8MB"
CONFIG_ESP_CONSOLE_USB_SERIAL_JTAG=y
CONFIG_ESP_CONSOLE_SECONDARY_NONE=y
CONFIG_FREERTOS_UNICORE=y
# CONFIG_SPIRAM is not set
```
