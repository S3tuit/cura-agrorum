## firmware/components/node_core/Kconfig
```kconfig
menu "Node cycle"
config NODE_DEEP_SLEEP_SECONDS
    int "Deep sleep duration in seconds"
    range 10 900
    default 900
    help
        Production uses 900 seconds. Accelerated RF qualification uses 10.
config NODE_RF_SLEEP_OBSERVATION
    bool "Enable host-controlled RF test finalization"
    default n
    help
        Test builds only: emit a marker after cycle finalization and successful
        timer configuration, then require a nonce-bound host receipt before
        sleep. The final planned wake parks for ROM stop/capture. Missing
        receipt parks until reset; ordinary production leaves this disabled.
config NODE_RF_PHY_OBSERVATION
    bool "Capture passive PHY IRQ observations for RF qualification"
    depends on NODE_RF_SLEEP_OBSERVATION
    default n
    help
        Test builds only: link bounded passive radio wrappers and dump the
        observed IRQ/timing data at finalized sleep entry. Overflow fails RF
        verification. This does not inject events or change receive policy.
endmenu
```

## firmware/components/node_sensors/Kconfig
```kconfig
menu "Cura Agrorum sensor board configuration"

    config CURA_SOIL_0_GPIO
        int "Soil sensor channel 0 ADC GPIO"
        range 0 6
        default 0
        help
            Provisional ESP32-C6 ADC-capable GPIO for soil channel 0.

    config CURA_SOIL_1_GPIO
        int "Soil sensor channel 1 ADC GPIO"
        range 0 6
        default 1
        help
            Provisional ESP32-C6 ADC-capable GPIO for soil channel 1.

    config CURA_SOIL_ADC_GPIO
        int "Standalone maintenance soil ADC GPIO"
        range 0 48
        default CURA_SOIL_0_GPIO
        help
            Compatibility setting used by maintenance applications that call
            soil_sensor_read_mv() directly. Production node_sensors sampling
            uses CURA_SOIL_0_GPIO and CURA_SOIL_1_GPIO instead.

    config CURA_SENSOR_POWER_GATE_GPIO
        int "Active-low open-drain switched sensor rail GPIO"
        range 0 23
        default 2
        help
            Provisional GPIO. Pulling the P-MOSFET gate low enables the shared
            soil/DS18B20 rail. Releasing it lets the external 47 kOhm
            source-to-gate resistor default the rail to off.

    config CURA_SENSOR_POWER_STABILIZATION_MS
        int "Switched sensor rail stabilization time (ms)"
        range 1 5000
        default 200
        help
            Initial pilot value. Validate it against the selected probes.

    config CURA_DS18B20_GPIO
        int "DS18B20 1-Wire GPIO"
        range 0 23
        default 3

    config CURA_DS18B20_0_ROM
        string "DS18B20 channel 0 ROM identity"
        default "0000000000000000"
        help
            Exactly 16 hexadecimal digits. All zeroes means not provisioned.

    config CURA_DS18B20_1_ROM
        string "DS18B20 channel 1 ROM identity"
        default "0000000000000000"
        help
            Exactly 16 hexadecimal digits. All zeroes means not provisioned.

    config CURA_I2C_SDA_GPIO
        int "BME280 I2C SDA GPIO"
        range 0 23
        default 4

    config CURA_I2C_SCL_GPIO
        int "BME280 I2C SCL GPIO"
        range 0 23
        default 5

endmenu
```

## firmware/components/soil_sensor/Kconfig
```kconfig
menu "Soil Sensor Configuration"

    config CURA_SOIL_ADC_GPIO
        int "Soil ADC GPIO"
        range 0 39
        default 34
        help
            GPIO that reads soil sensor voltage.

    choice CURA_SOIL_ADC_ATTEN
        prompt "Soil ADC attenuation"
        default CURA_SOIL_ADC_ATTEN_DB_12
        help
            ADC attenuation used for soil sensor voltage readings.

        config CURA_SOIL_ADC_ATTEN_DB_0
            bool "0 dB"
        config CURA_SOIL_ADC_ATTEN_DB_2_5
            bool "2.5 dB"
        config CURA_SOIL_ADC_ATTEN_DB_6
            bool "6 dB"
        config CURA_SOIL_ADC_ATTEN_DB_12
            bool "12 dB"
    endchoice

endmenu
```

## firmware/components/sx1262_radio/Kconfig
```kconfig
menu "Cura Agrorum SX1262 radio configuration"

    config CURA_SX1262_SCLK_GPIO
        int "SX1262 SPI clock GPIO"
        range 7 7
        default 7
        help
            Fixed XIAO ESP32S3 wiring; see firmware/HARDWARE.md.

    config CURA_SX1262_MOSI_GPIO
        int "SX1262 SPI MOSI GPIO"
        range 9 9
        default 9
        help
            Fixed XIAO ESP32S3 wiring; see firmware/HARDWARE.md.

    config CURA_SX1262_MISO_GPIO
        int "SX1262 SPI MISO GPIO"
        range 8 8
        default 8
        help
            Fixed XIAO ESP32S3 wiring; see firmware/HARDWARE.md.

    config CURA_SX1262_CS_GPIO
        int "SX1262 SPI chip-select GPIO"
        range 41 41
        default 41
        help
            Fixed XIAO ESP32S3 wiring; see firmware/HARDWARE.md.

    config CURA_SX1262_RESET_GPIO
        int "SX1262 active-low reset GPIO"
        range 42 42
        default 42
        help
            Fixed XIAO ESP32S3 wiring; see firmware/HARDWARE.md.

    config CURA_SX1262_BUSY_GPIO
        int "SX1262 BUSY GPIO"
        range 40 40
        default 40
        help
            Fixed XIAO ESP32S3 wiring; see firmware/HARDWARE.md.

    config CURA_SX1262_DIO1_GPIO
        int "SX1262 DIO1 interrupt GPIO"
        range 39 39
        default 39
        help
            Fixed XIAO ESP32S3 wiring; see firmware/HARDWARE.md.

    config CURA_SX1262_RF_ENABLE_GPIO
        int "Wio-SX1262 RF path enable GPIO"
        range 38 38
        default 38

endmenu
```

## firmware/hardware/radio/tests/component/sdkconfig.defaults
```kconfig
CONFIG_PARTITION_TABLE_CUSTOM=y
CONFIG_PARTITION_TABLE_CUSTOM_FILENAME="partitions.csv"
CONFIG_ESPTOOLPY_FLASHSIZE_8MB=y
CONFIG_ESPTOOLPY_FLASHSIZE="8MB"
CONFIG_XTAL_FREQ_40=y
CONFIG_ESP_MAIN_TASK_STACK_SIZE=12288
CONFIG_UNITY_ENABLE_64BIT=y
CONFIG_CURA_SX1262_SCLK_GPIO=7
CONFIG_CURA_SX1262_MOSI_GPIO=9
CONFIG_CURA_SX1262_MISO_GPIO=8
CONFIG_CURA_SX1262_CS_GPIO=41
CONFIG_CURA_SX1262_RESET_GPIO=42
CONFIG_CURA_SX1262_BUSY_GPIO=40
CONFIG_CURA_SX1262_DIO1_GPIO=39
CONFIG_CURA_SOIL_0_GPIO=1
CONFIG_CURA_SOIL_1_GPIO=2
CONFIG_CURA_SENSOR_POWER_GATE_GPIO=44
CONFIG_CURA_DS18B20_GPIO=4
CONFIG_CURA_I2C_SDA_GPIO=5
CONFIG_CURA_I2C_SCL_GPIO=6
CONFIG_CURA_SX1262_RF_ENABLE_GPIO=38

# D7/GPIO44 is the sensor gate; UART0 RX must never own it.
CONFIG_ESP_CONSOLE_USB_SERIAL_JTAG=y
CONFIG_ESP_CONSOLE_SECONDARY_NONE=y
CONFIG_FREERTOS_UNICORE=y
# CONFIG_SPIRAM is not set
```

## firmware/hardware/sensors/tests/carrier/sdkconfig.defaults
```kconfig
CONFIG_PARTITION_TABLE_CUSTOM=y
CONFIG_PARTITION_TABLE_CUSTOM_FILENAME="partitions.csv"
CONFIG_ESPTOOLPY_FLASHSIZE_8MB=y
CONFIG_ESPTOOLPY_FLASHSIZE="8MB"
CONFIG_XTAL_FREQ_40=y
CONFIG_ESP_MAIN_TASK_STACK_SIZE=8192
CONFIG_UNITY_ENABLE_IDF_TEST_RUNNER=y
CONFIG_UNITY_ENABLE_64BIT=y
CONFIG_CURA_SOIL_0_GPIO=1
CONFIG_CURA_SOIL_1_GPIO=2
CONFIG_CURA_SENSOR_POWER_GATE_GPIO=44
CONFIG_CURA_DS18B20_GPIO=4
CONFIG_CURA_I2C_SDA_GPIO=5
CONFIG_CURA_I2C_SCL_GPIO=6
CONFIG_CURA_SENSOR_POWER_STABILIZATION_MS=200
CONFIG_CURA_DS18B20_0_ROM="0000000000000000"
CONFIG_CURA_DS18B20_1_ROM="0000000000000000"

# D7/GPIO44 is the sensor gate; UART0 RX must never own it.
CONFIG_ESP_CONSOLE_USB_SERIAL_JTAG=y
CONFIG_ESP_CONSOLE_SECONDARY_NONE=y
CONFIG_FREERTOS_UNICORE=y
# CONFIG_SPIRAM is not set
```

## firmware/main/Kconfig.projbuild
```kconfig
menu "Device Configuration"

    config CURA_SOIL_ADC_GPIO
        int "Soil ADC GPIO"
        range 0 39
        default 34
        help
            GPIO that reads soil sensor voltage.

    choice CURA_SOIL_ADC_ATTEN
        prompt "Soil ADC attenuation"
        default CURA_SOIL_ADC_ATTEN_DB_12
        help
            ADC attenuation used for soil sensor voltage readings.

        config CURA_SOIL_ADC_ATTEN_DB_0
            bool "0 dB"
        config CURA_SOIL_ADC_ATTEN_DB_2_5
            bool "2.5 dB"
        config CURA_SOIL_ADC_ATTEN_DB_6
            bool "6 dB"
        config CURA_SOIL_ADC_ATTEN_DB_12
            bool "12 dB"
    endchoice

    config CURA_DS18B20_GPIO
        int "DS18B20 GPIO"
        range 0 39
        default 4
        help
            GPIO used for the 1-Wire bus.

    choice CURA_DS18B20_RESOLUTION
        prompt "DS18B20 resolution"
        default CURA_DS18B20_RESOLUTION_12B
        help
            DS18B20 temperature conversion resolution.

        config CURA_DS18B20_RESOLUTION_9B
            bool "9 bit"
        config CURA_DS18B20_RESOLUTION_10B
            bool "10 bit"
        config CURA_DS18B20_RESOLUTION_11B
            bool "11 bit"
        config CURA_DS18B20_RESOLUTION_12B
            bool "12 bit"
    endchoice

    choice CURA_ENV280_I2C_PORT
        prompt "ENV280 I2C port"
        default CURA_ENV280_I2C_PORT_0
        help
            ESP32 I2C controller used for BME280 communication.

        config CURA_ENV280_I2C_PORT_0
            bool "I2C_NUM_0"
        config CURA_ENV280_I2C_PORT_1
            bool "I2C_NUM_1"
    endchoice

    config CURA_ENV280_I2C_SDA_GPIO
        int "ENV280 I2C SDA GPIO"
        range 0 39
        default 21
        help
            GPIO used for I2C SDA.

    config CURA_ENV280_I2C_SCL_GPIO
        int "ENV280 I2C SCL GPIO"
        range 0 39
        default 22
        help
            GPIO used for I2C SCL.

    config CURA_ENV280_I2C_FREQ_HZ
        int "ENV280 I2C frequency in Hz"
        range 1 1000000
        default 100000
        help
            I2C clock frequency used for BME280 communication.

    config CURA_ENV280_I2C_ADDR
        hex "ENV280 I2C address"
        range 0x00 0x7f
        default 0x76
        help
            BME280 I2C address. 0x76 matches BMP280_I2C_ADDRESS_0.

endmenu

menu "WiFi Configuration"

    config ESP_WIFI_SSID
        string "WiFi SSID"
        default "cura-field"
        help
            SSID (network name) for the ESP32 to connect to.

    config ESP_WIFI_PASSWORD
        string "WiFi Password"
        default "cura-field-password"
        help
            WiFi password (WPA or WPA2) for the ESP32 to use.

    config ESP_MAXIMUM_RETRY
        int "Maximum retry"
        default 5
        help
            Maximum WiFi connection retries before failing.

    config CURA_GATEWAY_IPV4_ADDR
        string "Gateway IPv4 address"
        default "10.42.0.1"
        help
            Static IPv4 address of the laptop gateway on the field hotspot.

    config CURA_GATEWAY_PORT
        int "Gateway TCP port"
        range 1 65535
        default 18032
        help
            TCP port where the Cura Agrorum server listens.

    config CURA_SYNC_EVERY_N_BOOTS
        int "Try WiFi sync every N boots"
        range 1 2147483647
        default 10
        help
            Number of boots between WiFi sync attempts. Boot 0 is a sync boot,
            so resetting the node forces an immediate sync attempt.

    config CURA_WIFI_CONNECT_TIMEOUT_MS
        int "Total WiFi connection timeout in milliseconds"
        range 1000 60000
        default 8000
        help
            Maximum time to wait for the field hotspot association and DHCP.

    config CURA_TCP_CONNECT_TIMEOUT_MS
        int "TCP connect timeout in milliseconds"
        default 3000
        help
            Time to wait while opening a TCP connection to the gateway.

    config CURA_TCP_SEND_TIMEOUT_MS
        int "TCP send timeout in milliseconds"
        default 3000
        help
            Time to wait while sending a TCP frame to the gateway.

    config CURA_TCP_READ_TIMEOUT_MS
        int "TCP read timeout in milliseconds"
        default 3000
        help
            Time to wait while reading a TCP frame from the gateway.

endmenu

menu "Debug Configuration"

    config CURA_PROFILE_ENABLED
        bool "Enable profiling logs"
        default n
        help
            Enables PROFILE_START() and PROFILE_MARK() timing logs for
            measuring firmware execution time while debugging.

endmenu
```

## firmware/test_apps/on_device/sdkconfig.defaults
```kconfig
CONFIG_PARTITION_TABLE_CUSTOM=y
CONFIG_PARTITION_TABLE_CUSTOM_FILENAME="partitions.csv"
CONFIG_ESPTOOLPY_FLASHSIZE_4MB=y
CONFIG_ESPTOOLPY_FLASHSIZE="4MB"
CONFIG_XTAL_FREQ_40=y
CONFIG_XTAL_FREQ=40
CONFIG_RTC_CLK_SRC_INT_RC=y
CONFIG_ESP_MAIN_TASK_STACK_SIZE=8192
CONFIG_UNITY_ENABLE_IDF_TEST_RUNNER=y
CONFIG_UNITY_ENABLE_64BIT=y
# CONFIG_LITTLEFS_USE_MTIME is not set
```

## firmware/tests/target/sdkconfig.defaults
```kconfig
CONFIG_PARTITION_TABLE_CUSTOM=y
CONFIG_PARTITION_TABLE_CUSTOM_FILENAME="partitions.csv"
CONFIG_ESPTOOLPY_FLASHSIZE_8MB=y
CONFIG_ESPTOOLPY_FLASHSIZE="8MB"
CONFIG_XTAL_FREQ_40=y
CONFIG_XTAL_FREQ=40
CONFIG_RTC_CLK_SRC_INT_RC=y
CONFIG_ESP_MAIN_TASK_STACK_SIZE=8192
CONFIG_UNITY_ENABLE_IDF_TEST_RUNNER=y
CONFIG_UNITY_ENABLE_64BIT=y
# CONFIG_LITTLEFS_USE_MTIME is not set

# D7/GPIO44 is the sensor gate; UART0 RX must never own it.
CONFIG_ESP_CONSOLE_USB_SERIAL_JTAG=y
CONFIG_ESP_CONSOLE_SECONDARY_NONE=y
CONFIG_FREERTOS_UNICORE=y
# CONFIG_SPIRAM is not set
```

## firmware/tmp/sdkconfig.defaults
```kconfig
CONFIG_ESPTOOLPY_FLASHSIZE_4MB=y
CONFIG_ESPTOOLPY_FLASHSIZE="4MB"
CONFIG_SPI_FLASH_SUPPORT_BOYA_CHIP=y

CONFIG_XTAL_FREQ_40=y
CONFIG_XTAL_FREQ=40
```
